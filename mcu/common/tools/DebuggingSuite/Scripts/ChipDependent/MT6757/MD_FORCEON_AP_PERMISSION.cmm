;force on all AP access MD permission 

D.S SD:0xF0060090 %LE %LONG 0x0000FFFF
D.S SD:0xF0060094 %LE %LONG 0x0000FFFF
D.S SD:0xF0060098 %LE %LONG 0x0000FFFF
D.S SD:0xF006009C %LE %LONG 0x0000FFFF

D.S SD:0xF00600A0 %LE %LONG 0x0000FFFF
D.S SD:0xF00600A4 %LE %LONG 0x0000FFFF
D.S SD:0xF00600A8 %LE %LONG 0x0000FFFF
D.S SD:0xF00600AC %LE %LONG 0x0000FFFF

D.S SD:0xF00600C4 %LE %LONG 0x00000007

