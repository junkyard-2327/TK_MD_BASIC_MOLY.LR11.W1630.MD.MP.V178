
winclear
menu.reset
menu.reprogram MD_DualCoreDebugging_PlatformInit
winclear