
;D.S UM:0xF60F0008 %LE %LONG 0xFFFFFFFB

;Init 208M clock
&208M_MODE=1
;; 0: force on
;; 1: only enable
PRINT "Everest MDPLL(208Mhz) config start"
IF &208M_MODE==0
(
    PRINT "Force on Everest MDPLL(208Mhz)"
    D.S SD:0xF0060090 %LE %LONG 0x0000FFFF
    D.S SD:0xF0060094 %LE %LONG 0x0000FFFF
    D.S SD:0xF0060098 %LE %LONG 0x0000FFFF
    D.S SD:0xF006009C %LE %LONG 0x0000FFFF
    D.S SD:0xF00600C4 %LE %LONG 0x00000007
    D.S SD:0xF616B000 %LE %LONG 0xB2000082

    D.S SD:0xC000C000 %LE %LONG 0x000039F1
    Wait 1.0ms
    D.S SD:0xC000C000 %LE %LONG 0x000039F3
    D.S SD:0xC000C2C8 %LE %LONG 0x000002E9
)
ELSE
(
    PRINT "Only enable Everest MDPLL(208Mhz)"
    ;Init 208M clock
    D.S SD:0xF0060090 %LE %LONG 0x0000FFFF
    D.S SD:0xF0060094 %LE %LONG 0x0000FFFF
    D.S SD:0xF0060098 %LE %LONG 0x0000FFFF
    D.S SD:0xF006009C %LE %LONG 0x0000FFFF
    D.S SD:0xF00600C4 %LE %LONG 0x00000007
    D.S SD:0xF616B000 %LE %LONG 0xB2000082

    D.S SD:0xC000C2C8 %LE %LONG 0x00002EE9

    D.S SD:0xC000C000 %LE %LONG 0x000039F1
    Wait 1.0ms
    D.S SD:0xC000C000 %LE %LONG 0x000039F3
    Wait 1.0ms
    D.S SD:0xC000C2C8 %LE %LONG 0x00002EE8
    D.S SD:0xC000C2C8 %LE %LONG 0x00000268
    D.S SD:0xC000C2C8 %LE %LONG 0x00000068
)
PRINT "Everest MDPLL(208Mhz) config end"

;force cg off(clock on)
&FORCE_CG=0
;; 0: do nothing
;; 1: force cg off(clock on)
IF &FORCE_CG==1
(
    Do MD_force_swcg_off.cmm
)

;PMIC SRCKKEN
D.S SD:0xC0006008 %LE %LONG 0x00215830

;Config GPIO
Do MT6797_GPIO_Additional_Init.cmm
;
