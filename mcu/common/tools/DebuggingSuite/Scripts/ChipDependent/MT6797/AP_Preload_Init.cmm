;*****************************************************************************
;  Copyright Statement:
;  --------------------
;  This software is protected by Copyright and the information contained
;  herein is confidential. The software may not be copied and the information
;  contained herein may not be used or disclosed except with the written
;  permission of MediaTek Inc. (C) 2011
;
;*****************************************************************************
;;================================================
;; PURPOSE:     FPGA Bring Up
;; CREATE_DATE: 2015/03/20
;; NOTE:
;;================================================
; Specify Core Number
;=================================================

&NR_CPUS=1
; cluster 0 corebase: 0x8007000, 0x8007200, 0x8007400, 0x8007600
; cluster 1 corebase: 0x8009000, 0x8009200, 0x8009400, 0x8009600

;=================================================
; Initialize CPU
;=================================================
&WDT_TEST=0
if &WDT_TEST==0
(
	RESET
	SYSTEM.OPTION ENRESET ON
)

SYSTEM.RESET
SYSTEM.OPTION ENRESET ON
SYSTEM.OPTION RESBREAK OFF
SYSTEM.OPTION WAITRESET OFF

SYSTEM.JTAGCLOCK 10.MHz;

;SYSTEM.CPU CortexA7MPCore
SYStem.CPU CORTEXA53;

SYStem.multicore SWDP OFF
;R-T Memory Access
SYSTEM.MULTICORE MEMORYACCESSPORT 0
SYSTEM.MULTICORE DEBUGACCESSPORT 1

;SYSTEM.MULTICORE COREBASE APB:0x80070000
;Setting Core debug register access
if &NR_CPUS==1
(
    SYStem.CONFIG CORENUMBER 1;
    SYStem.CONFIG COREBASE 0x80410000;
    SYStem.CONFIG CTIBASE 0x80420000;
)
else
(
    SYSTEM.CONFIG CORENUMBER 2;
    SYSTEM.CONFIG COREBASE 0x80810000 0x80910000;
    SYStem.CONFIG CTIBASE 0x80820000 0x80920000;
)

;=================================================
; Attach and Stop CPU
;=================================================
SYStem.Up
wait 200.us

SETUP.IMASKHLL ON
SETUP.IMASKASM ON

;start do pmic_setting.cmm
;; gpu sram ldo default on to 1.15v
D.S SD:0x10001fc0 %LE %LONG 0x0d0d0d0d
D.S SD:0x10001fc4 %LE %LONG 0x0d0d0d0d
D.S SD:0x10001fbc %LE %LONG 0xff

;; mfg_async on to resolve pd control of gpu sram floating

D.S SD:0x10006000 %LE %LONG 0x0b160001
D.S SD:0x10006334 %LE %LONG 0x1E
D.S SD:0x10006334 %LE %LONG 0xE
D.S SD:0x10006334 %LE %LONG 0xC
D.S SD:0x10006334 %LE %LONG 0xD
;end do pmic_setting



;enable L2C 256KB
D.S SD:0x10220000 %LE %LONG 0x00000100 ;Enable L2C share SRAM, cluster 0
D.S SD:0x10220000 %LE %LONG 0x00001100 ;Enable L2C share SRAM, cluster 0

; set_hw_breakpoint_by_def
; setting attribute of breakpoints
Break.Select Program OnChip
Break.Select Hll OnChip
Break.Select Spot OnChip
Break.Select Read OnChip
Break.Select Write OnChip

D.S C15:0x1 0				; Turn off MMU

; disable wdt (debug purpose)
D.S SD:0x10007000 %LE %LONG 0x22000064

print "loading pre-loader image"
d.load.elf AP_Preloader.elf

Y.SPATH.RESET ; reset all source path
Y.SPATH.SRD ../../platform/mt6797/src/init
Y.SPATH.SRD ../../platform/mt6797/src/core
Y.SPATH.SRD ../../platform/mt6797/src/drivers
Y.SPATH.SRD ../../platform/mt6797/src/security
Y.SPATH.SRD ../../custom/evb6797_64
;Y.SPATH.SRD ../../protect-private/security/ASF/preloader


Break.Select Program OnChip
Break.Select Hll OnChip
Break.Select Spot OnChip
Break.Select Read OnChip
Break.Select Write OnChip

R.S T 0
;winclear
d.l
enddo

