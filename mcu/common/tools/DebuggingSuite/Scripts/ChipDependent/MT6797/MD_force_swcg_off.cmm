&MEM_CLASS="sd"

PRINT "Everest force cg off(clock on) start"
;; Pcore
&BASE_MADDR_MDSYS_CLKCTL=(0xF0120000)
&MD_INFRA_CKEN=(&BASE_MADDR_MDSYS_CLKCTL+0x44)
&MD_PERI_CKEN=(&BASE_MADDR_MDSYS_CLKCTL+0x48)
&ARM7_CKEN=(&BASE_MADDR_MDSYS_CLKCTL+0x4C)
D.S &MD_INFRA_CKEN %LE %LONG 0xFFFFFFFF
D.S &MD_PERI_CKEN %LE %LONG 0xFFFFFFFF
D.S &ARM7_CKEN %LE %LONG 0xFFFFFFFF

;; L1core
&L1_BASE_MADDR_MDL1_CONF=(0xF60F0000)
&L1_BASE_MADDR_L1MCU_CONF=(0xF6800000)
&L1_BASE_MADDR_MD2G_CONFG=(0xF7700000)
&MD_L1MCU_CG_CLR=(&L1_BASE_MADDR_L1MCU_CONF+0x08)
&MD_L1_PLL_BASE=(0xF0140000)
&MD_L1_MDPLL_CTL2=(&MD_L1_PLL_BASE+0x48)
&MD_L1AO_PERI_CG_CRL=(&L1_BASE_MADDR_MDL1_CONF+0x08)
&MD_MD2GSYS_IRDBG_CG_CRL=(&L1_BASE_MADDR_MD2G_CONFG+0x20)

D.S &MD_L1MCU_CG_CLR %LE %LONG 0xFFFFFFFF
d.s &MD_L1_MDPLL_CTL2 %long %le data.long(&MEM_CLASS:&MD_L1_MDPLL_CTL2)|0x400000
D.S &MD_L1AO_PERI_CG_CRL %LE %LONG 0xFFFFFFFF
d.s &MD_MD2GSYS_IRDBG_CG_CRL %long %le data.long(&MEM_CLASS:&MD_MD2GSYS_IRDBG_CG_CRL)|0x02000

PRINT "Everest force cg off(clock on) end"