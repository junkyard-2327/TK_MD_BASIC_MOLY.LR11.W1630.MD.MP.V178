;===============================================
;CMM START
;===============================================

; ==================
; set breakpoint
; ==================
DELeteBreak
setbreak kal_fatal_error_handler_int %hw
setbreak kal_assert_fail_specific %hw
;setbreak IdleTask %hw
;setbreak TCCT_Schedule %hw

;setbreak kal_assert_fail_line %hw
;setbreak kal_assert_fail_ext %hw
;setbreak kal_assert_fail_dump %hw
;setbreak kal_assert_fail %hw
;setbreak kal_assert_fail_native %hw
setbreak INT_ExceptionSwitchSP %hw

PRINT "BreakPoint set-up done."
ENDDO