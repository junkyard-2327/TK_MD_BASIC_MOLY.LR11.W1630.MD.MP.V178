;;;;;;;;;; register base
&MD_CLKSW_BASE=0xF0150000
&BASE_ADDR_MDTOP_PLLMIXED=0xF0140000
&MEM_CLASS="sd"

;;;;;;;;;; options

;;;;;;;;;; register address

&REG_MDTOP_CLKSW_CLKSEL_VER=(&MD_CLKSW_BASE+0x0000)
&REG_MDTOP_CLKSW_CLKSEL_CTL=(&MD_CLKSW_BASE+0x0024)
&REG_MDTOP_CLKSW_FLEXCKGEN_SEL0=(&MD_CLKSW_BASE+0x0028)
&REG_MDTOP_CLKSW_FLEXCKGEN_STS0=(&MD_CLKSW_BASE+0x0030)

&REG_MDTOP_PLLMIXED_PSMCUPLL_CTL0=(&BASE_ADDR_MDTOP_PLLMIXED+0x004C)
&REG_MDTOP_PLLMIXED_L1MCUPLL_CTL0=(&BASE_ADDR_MDTOP_PLLMIXED+0x0054)
&REG_MDTOP_PLLMIXED_PSMCUPLL_STS=(&BASE_ADDR_MDTOP_PLLMIXED+0x0600)
&REG_MDTOP_PLLMIXED_L1MCUPLL_STS=(&BASE_ADDR_MDTOP_PLLMIXED+0x0604)

;;;;;;;;;;;;;;;;;;;;;;;;;;;;;;;;;;;;;;;;;;;;;;;;;;;;;;
;; 	// Sequence to enable PLL
;;;;;;;;;;;;;;;;;;;;;;;;;;;;;;;;;;;;;;;;;;;;;;;;;;;;;;


PRINT "MD PLL init cmm start"
;; 	
wait 1.ms

d.s &REG_MDTOP_CLKSW_FLEXCKGEN_SEL0 %word %le data.word(&MEM_CLASS:&REG_MDTOP_CLKSW_FLEXCKGEN_SEL0)|0x3000		
d.s &REG_MDTOP_PLLMIXED_PSMCUPLL_CTL0 %word %le 0x800EE762
wait 5.ms

d.s &REG_MDTOP_CLKSW_CLKSEL_CTL %word %le data.word(&MEM_CLASS:&REG_MDTOP_CLKSW_CLKSEL_CTL)|0x0003
d.s &REG_MDTOP_PLLMIXED_L1MCUPLL_CTL0 %word %le 0x8015EC4F
wait 5.ms

d.s &REG_MDTOP_CLKSW_CLKSEL_CTL %word %le data.word(&MEM_CLASS:&REG_MDTOP_CLKSW_CLKSEL_CTL)|0x3FF0C
wait 1.ms

PRINT "MD PLL init OK, please check result by frequency meter"

;STOP
;ENDDO

