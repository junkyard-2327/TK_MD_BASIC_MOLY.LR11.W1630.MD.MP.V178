
;D.S UM:0xF60F0008 %LE %LONG 0xFFFFFFFB

;Init 208M clock
D.S SD:0xF0060090 %LE %LONG 0x0000FFFF
D.S SD:0xF0060094 %LE %LONG 0x0000FFFF
D.S SD:0xF0060098 %LE %LONG 0x0000FFFF
D.S SD:0xF006009C %LE %LONG 0x0000FFFF
D.S SD:0xF00600C4 %LE %LONG 0x00000007
D.S SD:0xF616B000 %LE %LONG 0xB2000082

D.S SD:0xC000C000 %LE %LONG 0x000039F1
Wait 1.0ms
D.S SD:0xC000C000 %LE %LONG 0x000039F3
D.S SD:0xC000C2C8 %LE %LONG 0x000002E9

;PMIC SRCKKEN
D.S SD:0xC0006008 %LE %LONG 0x00215830

;Config GPIO
Do MT6750_GPIO_Additional_Init.cmm
;
