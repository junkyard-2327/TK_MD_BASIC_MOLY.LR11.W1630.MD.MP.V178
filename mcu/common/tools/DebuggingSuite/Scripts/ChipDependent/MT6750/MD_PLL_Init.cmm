;;;;;;;;;; register base

&MEM_CLASS="sd"

&MD_CLKSW_BASE=(0xF0150000)
&MD_GLOBAL_CON_DCM_BASE=(0xF0130000)
&PSMCU_MISC_BASE=(0xF0200000)
&MD_PERI_MISC_BASE=(0xF0060000)
&MDL1A0_BASE=(0xF60F0000)
&BASE_ADDR_MDTOP_PLLMIXED=(0xF0140000)
&BASE_ADDR_MDSYS_CLKCTL=(0xF0120000)
&L1_BASE_MADDR_MDL1_CONF=(0xF60F0000)

&MD_PLL_MAGIC_NUM=0x67550000

;;;;;;;;;; options
;; 0: no degrade, 1: only PSMCU/BUS degrade 10%, 2: all degrade 10%
&MD_PLL_FREQUENCY_DEGRADE=0


;;;;;;;;;; register address

&R_CLKSEL_CTL=(&MD_CLKSW_BASE+0x0024)
&R_FLEXCKGEN_SEL0=(&MD_CLKSW_BASE+0x0028)
&R_FLEXCKGEN_SEL1=(&MD_CLKSW_BASE+0x002C)
&R_FLEXCKGEN_SEL2=(&MD_CLKSW_BASE+0x0044)
&R_PLL_STS=(&MD_CLKSW_BASE+0x0040)
&R_FLEXCKGEN_STS0=(&MD_CLKSW_BASE+0x0030)
&R_FLEXCKGEN_STS1=(&MD_CLKSW_BASE+0x0034)
&R_FLEXCKGEN_STS2=(&MD_CLKSW_BASE+0x0048)
&R_PSMCU_DCM_CTL0=(&MD_GLOBAL_CON_DCM_BASE+0x0010)
&R_PSMCU_DCM_CTL1=(&MD_GLOBAL_CON_DCM_BASE+0x0014)
&R_ARM7_DCM_CTL0=(&MD_GLOBAL_CON_DCM_BASE+0x0020)
&R_ARM7_DCM_CTL1=(&MD_GLOBAL_CON_DCM_BASE+0x0024)
&MD_GLOBAL_CON_DUMMY=(&MD_GLOBAL_CON_DCM_BASE+0x1000)
&R_DCM_SHR_SET_CTL=(&BASE_ADDR_MDSYS_CLKCTL+0x0004)
&R_LTEL2_BUS_DCM_CTL=(&BASE_ADDR_MDSYS_CLKCTL+0x0010)
&R_MDDMA_BUS_DCM_CTL=(&BASE_ADDR_MDSYS_CLKCTL+0x0014)
&R_MDREG_BUS_DCM_CTL=(&BASE_ADDR_MDSYS_CLKCTL+0x0018)
&R_MODULE_BUS2X_DCM_CTL=(&BASE_ADDR_MDSYS_CLKCTL+0x001C)
&R_MODULE_BUS1X_DCM_CTL=(&BASE_ADDR_MDSYS_CLKCTL+0x0020)
&R_MDINFRA_CKEN=(&BASE_ADDR_MDSYS_CLKCTL+0x0044)		
&R_MDPERI_CKEN=(&BASE_ADDR_MDSYS_CLKCTL+0x0048)
&R_MDPERI_DCM_MASK=(&BASE_ADDR_MDSYS_CLKCTL+0x0064)
&R_PSMCU_AO_CLK_CTL=(&BASE_ADDR_MDSYS_CLKCTL+0x00C0)
&R_L1_PMS=(&MD_PERI_MISC_BASE+0x00C4)
&REG_DCM_PLLCK_SEL=(&MDL1A0_BASE+0x0188)
&R_L1MCU_PWR_AWARE=(&MDL1A0_BASE+0x0190)
&R_L1AO_PWR_AWARE=(&MDL1A0_BASE+0x0194)
&R_BUSL2DCM_CON3=(&MDL1A0_BASE+0x0198)
&R_L1MCU_DCM_CON2=(&MDL1A0_BASE+0x0184)
&R_L1MCU_DCM_CON=(&MDL1A0_BASE+0x0180)

;;;;;;;;;;;;;;;;;;;;;;;;;;;;;;;;;;;;;;;;;;;;;;;;;;;;;;
;; 	// Sequence to enable PLL
;;;;;;;;;;;;;;;;;;;;;;;;;;;;;;;;;;;;;;;;;;;;;;;;;;;;;;
&TARGET_DUMMY_REGISTER=0
;;//read dummy register
&TARGET_DUMMY_REGISTER=data.long(&MEM_CLASS:&MD_GLOBAL_CON_DUMMY)


IF &MD_PLL_MAGIC_NUM==&TARGET_DUMMY_REGISTER
(					  
   PRINT "JADE MD PLL has init before!!!"
    GOSUB PLL_INIT_END
)					

PRINT "JADE MD PLL init cmm start"
;; 	
wait 1.ms

;;//enable L1 permission
d.s &R_L1_PMS %long %le data.long(&MEM_CLASS:&R_L1_PMS)|0x7
;;// modify PSMCU2EMI bus divider from 3 to 4.
d.s &R_PSMCU_AO_CLK_CTL %long %le data.long(&MEM_CLASS:&R_PSMCU_AO_CLK_CTL)|0x83		

;;//lock dcm bus
d.s &R_L1MCU_PWR_AWARE %long %le data.long(&MEM_CLASS:&R_L1MCU_PWR_AWARE)|0x10000		
;;//lock dcm bus	
d.s &R_L1AO_PWR_AWARE %long %le data.long(&MEM_CLASS:&R_L1AO_PWR_AWARE)|0x10000		
;;//busL2 DCM div 8/normal div 1/ clkslow_en/clock from PLL /debounce enable/ debounce time 7T 	
d.s &R_BUSL2DCM_CON3 %long %le 0x0001FDE7
;;// DCM div 16/normal div 1/clkslow_en/ clock from PLL / dcm enable /debounce enable /debounce time 15T	
d.s &R_L1MCU_DCM_CON %long %le 0x0000FDEF
;;//DCM config toggle = 0		
d.s &R_L1MCU_DCM_CON2 %long %le 0x0
;;//DCM config toggle  = 1 / 	
d.s &R_L1MCU_DCM_CON2 %long %le 0x80000000

;;/*Wait PSMCU PLL ready*/
wait 1.ms
;;/*Switch clock, 0: 26MHz, 1: PLL*/
d.s &R_CLKSEL_CTL %long %le data.long(&MEM_CLASS:&R_CLKSEL_CTL)|0x2		

;;/*Wait L1MCU PLL ready*/
wait 1.ms
;;// Bit  8: L1MCU_CK = L1MCUPLL
d.s &R_CLKSEL_CTL %long %le data.long(&MEM_CLASS:&R_CLKSEL_CTL)|0x100		

;;/*DFE/CMP/ICC/IMC clock src select*/
d.s &R_FLEXCKGEN_SEL1 %long %le 0x30302020

;;/*IMC/MD2G clock src select */
d.s &R_FLEXCKGEN_SEL2 %long %le 0x00002030
;;/*Wait DFE/IMC PLL ready*/ /*Wait L1SYS clock ready*/
wait 1.ms
;;/*Switch L1SYS clock to PLL clock*/
d.s &R_CLKSEL_CTL %long %le data.long(&MEM_CLASS:&R_CLKSEL_CTL)|0x3fe00		

;;/*MD BUS/ARM7 clock src select */
d.s &R_FLEXCKGEN_SEL0 %long %le 0x30203031

;;//magic number set into dummy register as MD PLL has init record
d.s &MD_GLOBAL_CON_DUMMY %long %le &MD_PLL_MAGIC_NUM

;;/*PSMCU DCM*/
d.s &R_PSMCU_DCM_CTL0 %long %le data.long(&MEM_CLASS:&R_PSMCU_DCM_CTL0)|0x00F1F006		
d.s &R_PSMCU_DCM_CTL1 %long %le data.long(&MEM_CLASS:&R_PSMCU_DCM_CTL1)|0x26		
;;/*ARM7 DCM*/
d.s &R_ARM7_DCM_CTL0 %long %le data.long(&MEM_CLASS:&R_ARM7_DCM_CTL0)|0x00F1F006		
d.s &R_DCM_SHR_SET_CTL %long %le data.long(&MEM_CLASS:&R_DCM_SHR_SET_CTL)|0x00014110		

;;/*LTEL2 BUS DCM*/
d.s &R_LTEL2_BUS_DCM_CTL %long %le data.long(&MEM_CLASS:&R_LTEL2_BUS_DCM_CTL)|0x1		
;;/*MDDMA BUS DCM*/
d.s &R_MDDMA_BUS_DCM_CTL %long %le data.long(&MEM_CLASS:&R_MDDMA_BUS_DCM_CTL)|0x1		
;;/*MDREG BUS DCM*/
d.s &R_MDREG_BUS_DCM_CTL %long %le data.long(&MEM_CLASS:&R_MDREG_BUS_DCM_CTL)|0x1		
;;/*MODULE BUS2X DCM*/
d.s &R_MODULE_BUS2X_DCM_CTL %long %le data.long(&MEM_CLASS:&R_MODULE_BUS2X_DCM_CTL)|0x1		
;;/*MODULE BUS1X DCM*/
d.s &R_MODULE_BUS1X_DCM_CTL %long %le data.long(&MEM_CLASS:&R_MODULE_BUS1X_DCM_CTL)|0x1		

;;/*MD perisys AHB master/slave DCM enable*/
d.s &R_MDINFRA_CKEN %long %le data.long(&MEM_CLASS:&R_MDINFRA_CKEN)|0xC000001F	

;;/*MD debugsys DCM enable*/
d.s &R_MDPERI_CKEN %long %le data.long(&MEM_CLASS:&R_MDPERI_CKEN)|0x8003FFFF		

;;/*SET MDRGU, MDTOPSM, MDOSTIMER, MDTOPSM DCM MASK*/
d.s &R_MDPERI_DCM_MASK %long %le data.long(&MEM_CLASS:&R_MDPERI_DCM_MASK)|0x00001E00		
d.s &REG_DCM_PLLCK_SEL %long %le data.long(&MEM_CLASS:&REG_DCM_PLLCK_SEL)|(0x80)		
;;// wait DCM config done, then switch BUS clock src to PLL
wait 1.ms
d.s &R_CLKSEL_CTL %long %le data.long(&MEM_CLASS:&R_CLKSEL_CTL)|0x1		

PRINT "JADE MD PLL init OK, please check result by frequency meter"

&REG_MDTOP_PLLMIXED_PSMCUPLL_CTL0=(&BASE_ADDR_MDTOP_PLLMIXED+0x004C)
&REG_MDTOP_PLLMIXED_L1MCUPLL_CTL0=(&BASE_ADDR_MDTOP_PLLMIXED+0x0054)
&REG_MDTOP_PLLMIXED_BRPPLL_CTL0=(&BASE_ADDR_MDTOP_PLLMIXED+0x005C)
&REG_MDTOP_PLLMIXED_EQPLL_CTL0=(&BASE_ADDR_MDTOP_PLLMIXED+0x0064)
&REG_MDTOP_PLLMIXED_IMCPLL_CTL0=(&BASE_ADDR_MDTOP_PLLMIXED+0x006C)
&REG_MDTOP_PLLMIXED_ICCPLL_CTL0=(&BASE_ADDR_MDTOP_PLLMIXED+0x0074)
&REG_MDTOP_PLLMIXED_CMPPLL_CTL0=(&BASE_ADDR_MDTOP_PLLMIXED+0x007C)
&REG_MDTOP_PLLMIXED_DFEPLL_CTL0=(&BASE_ADDR_MDTOP_PLLMIXED+0x0084)
&REG_MDTOP_PLLMIXED_MD2GPLL_CTL0=(&BASE_ADDR_MDTOP_PLLMIXED+0x008C)
&REG_MDTOP_PLLMIXED_INTFPLL_CTL0=(&BASE_ADDR_MDTOP_PLLMIXED+0x0094)

IF &MD_PLL_FREQUENCY_DEGRADE==1
(
;;// PS/L1MCU and MDBUS degrade 10%
	d.s &REG_MDTOP_PLLMIXED_PSMCUPLL_CTL0 %long %le (data.long(&MEM_CLASS:&REG_MDTOP_PLLMIXED_PSMCUPLL_CTL0)*9/2/5)|0x80000000
	d.s &REG_MDTOP_PLLMIXED_L1MCUPLL_CTL0 %long %le (data.long(&MEM_CLASS:&REG_MDTOP_PLLMIXED_L1MCUPLL_CTL0)*9/2/5)|0x80000000
	d.s &REG_MDTOP_PLLMIXED_EQPLL_CTL0 %long %le (data.long(&MEM_CLASS:&REG_MDTOP_PLLMIXED_EQPLL_CTL0)*9/2/5)|0x80000000
	PRINT "JADE PS/L1MCU and MDBUS Clock degrade 10%!!!"
	GOSUB PLL_INIT_END
)
ELSE IF &MD_PLL_FREQUENCY_DEGRADE==2
(
;;//all PLL degrade 10%
	d.s &REG_MDTOP_PLLMIXED_PSMCUPLL_CTL0 %long %le (data.long(&MEM_CLASS:&REG_MDTOP_PLLMIXED_PSMCUPLL_CTL0)*9/2/5)|0x80000000
	d.s &REG_MDTOP_PLLMIXED_L1MCUPLL_CTL0 %long %le (data.long(&MEM_CLASS:&REG_MDTOP_PLLMIXED_L1MCUPLL_CTL0)*9/2/5)|0x80000000
	d.s &REG_MDTOP_PLLMIXED_EQPLL_CTL0 %long %le (data.long(&MEM_CLASS:&REG_MDTOP_PLLMIXED_EQPLL_CTL0)*9/2/5)|0x80000000
	d.s &REG_MDTOP_PLLMIXED_BRPPLL_CTL0 %long %le (data.long(&MEM_CLASS:&REG_MDTOP_PLLMIXED_BRPPLL_CTL0)*9/2/5)|0x80000000
	d.s &REG_MDTOP_PLLMIXED_IMCPLL_CTL0 %long %le (data.long(&MEM_CLASS:&REG_MDTOP_PLLMIXED_IMCPLL_CTL0)*9/2/5)|0x80000000
	d.s &REG_MDTOP_PLLMIXED_ICCPLL_CTL0 %long %le (data.long(&MEM_CLASS:&REG_MDTOP_PLLMIXED_ICCPLL_CTL0)*9/2/5)|0x80000000
	d.s &REG_MDTOP_PLLMIXED_CMPPLL_CTL0 %long %le (data.long(&MEM_CLASS:&REG_MDTOP_PLLMIXED_CMPPLL_CTL0)*9/2/5)|0x80000000
	d.s &REG_MDTOP_PLLMIXED_DFEPLL_CTL0 %long %le (data.long(&MEM_CLASS:&REG_MDTOP_PLLMIXED_DFEPLL_CTL0)*9/2/5)|0x80000000
	d.s &REG_MDTOP_PLLMIXED_MD2GPLL_CTL0 %long %le (data.long(&MEM_CLASS:&REG_MDTOP_PLLMIXED_MD2GPLL_CTL0)*9/2/5)|0x80000000
	d.s &REG_MDTOP_PLLMIXED_INTFPLL_CTL0 %long %le (data.long(&MEM_CLASS:&REG_MDTOP_PLLMIXED_INTFPLL_CTL0)*9/2/5)|0x80000000
	PRINT "JADE all PLL degrade 10%!!!"
	GOSUB PLL_INIT_END
)

PLL_INIT_END:
PRINT "JADE MD PLL init END"

;STOP
;ENDDO

