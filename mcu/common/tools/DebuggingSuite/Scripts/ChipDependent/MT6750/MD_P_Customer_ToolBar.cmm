;===============================================
;CMM START
;This CMM for customer toolbar
;===============================================

; ==================
; Start DSP ToolBar
; ==================

menu.reprogram ECTDSP
menu.reprogram ECTWho

;===============================================
;CMM END
;===============================================
ENDDO