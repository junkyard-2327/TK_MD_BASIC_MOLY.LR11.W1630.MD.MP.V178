system.down
SYSTEM.OPTION.EnReset OFF
SYSTEM.OPTION.WaitReset OFF
System.Option ResBreak OFF
System.OPTION TRST off
system.JtagClock 8MHz
CPUTYPE CORTEXR4
system.cpu cortexr4
system.multicore SWDP on

; setting attribute of breakpoints
Break.Select Program OnChip
Break.Select Hll OnChip
Break.Select Read OnChip
Break.Select Write OnChip

sys.m prepare
Data.Set EAHB:0xF60F020C %Long 0xE3000710
system.down

system.multicore COREBASE 0xF0091000
system.up