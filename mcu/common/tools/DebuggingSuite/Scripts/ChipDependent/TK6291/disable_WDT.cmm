
&BASE_MADDR_MDRGU=0x800F0000
&BASE_MADDR_APRGU=0x93670000
&L1_BASE_ADDR_L1RGU=0x86010000

D.S SD:&BASE_MADDR_MDRGU+0x0100 %LE %LONG (0x55000000|data.long(SD:&BASE_MADDR_MDRGU+0x0100)&~(0x1))
D.S SD:&BASE_MADDR_APRGU+0x0100 %LE %LONG (0x55000000|data.long(SD:&BASE_MADDR_APRGU+0x0100)&~(0x1))
D.S SD:&L1_BASE_ADDR_L1RGU %LE %LONG (0x2200|data.long(SD:&L1_BASE_ADDR_L1RGU)&~(0x1))