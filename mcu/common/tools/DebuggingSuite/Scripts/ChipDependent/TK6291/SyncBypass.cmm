;===============================================
;CMM START
;===============================================

D.S SD:INT_PCoreSchedulingSync %LE %WORD 0x1
D.S SD:INT_L1CoreSchedulingSync %LE %WORD 0x1