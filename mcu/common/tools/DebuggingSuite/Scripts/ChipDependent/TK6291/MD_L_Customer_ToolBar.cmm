;===============================================
;CMM START
;This CMM for customer toolbar
;===============================================

; ==================
; Start DSP ToolBar
; ==================

menu.reprogram LoadDSP

;===============================================
;CMM END
;===============================================
ENDDO