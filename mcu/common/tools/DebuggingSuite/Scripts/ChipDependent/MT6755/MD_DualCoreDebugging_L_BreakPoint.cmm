;===============================================
;CMM START
;===============================================

; ==================
; set breakpoint
; ==================
DELeteBreak
;setbreak kal_fatal_error_handler_int %hw
;setbreak kal_assert_fail_specific %hw
;setbreak IdleTask %hw
;setbreak TCCT_Schedule %hw

PRINT "BreakPoint set-up done."
ENDDO