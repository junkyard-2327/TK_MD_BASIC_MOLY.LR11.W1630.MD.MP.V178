;;;;;;;;;;;;;;;;;;;;;;;;;;;;;;;;;;;;;;;;;;;;;;;;;;;;;;;;;;;;;;;;;;;;;;;;;;;;;;;
;; MT6752 MD1 Frequency Meter
;;;;;;;;;;;;;;;;;;;;;;;;;;;;;;;;;;;;;;;;;;;;;;;;;;;;;;;;;;;;;;;;;;;;;;;;;;;;;;;

LOCAL &opt_gui_enable
&opt_gui_enable=0

LOCAL &key_in
&key_in=0

LOCAL &opt_cvd_connect
&opt_cvd_connect="none"

LOCAL &mclass           ;; Memory Class
;&mclass="eahb"
&mclass="pm"

LOCAL &pll_base         ;; MD PLL base address
;&pll_base=0x20120000    ;; Use APs view, since we use eahb memory class
&pll_base=0xF0150000

LOCAL &fqmtr_winset     ;; Frequency Meter Windoiw Setting (= Number of FIXED clock cycle)
&fqmtr_winset=0x1ff     ;; Choose 0x1ff in MT6592/MT6572/MT6582, notes that MT6589 choose 0x10
                        ;; This is hardware-depdndent

LOCAL &fqmtr_fcksel_val ;; Frequency Meter FIXED clock selection
&fqmtr_fcksel_val=0x1a  ;; Select 26Mhz by default

;;;;;;;;;;;;;;;;;;;;;;;;;;;;;;;;;;;;;;;;;;;;;;;;;;;;;;;;;;;;;;;;;;;;;;;;;;;;;;;;
&SRC_STR_1="L1SYS_INTF_clock"
&SRC_STR_2="L1SYS_MD2G_clock"
&SRC_STR_3="L1SYS_DFE_clock"
&SRC_STR_4="L1SYS_CMP_clock"
&SRC_STR_5="L1SYS_ICC_clock"
&SRC_STR_6="L1SYS_IMC_clock"
&SRC_STR_7="L1SYS_EQ_clock"
&SRC_STR_8="L1SYS_BRP_clock"
&SRC_STR_9="L1MCU_clock(before_DCM)"
&SRC_STR_10="ARM7_clock(before_DCM)"
&SRC_STR_11="PSMCU_clock(before_DCM)"
&SRC_STR_12="ATB_clock"
&SRC_STR_13="MDSYS_208M_clock"
&SRC_STR_14="MDSYS_pseudo_phy_clock"
&SRC_STR_15="MDSYS_XTAL_clock(26M)"
&SRC_STR_16="MD_debug_system_clock"
&SRC_STR_17="MD_BUS_clock(before_DCM)"
&SRC_STR_18="32k_clock"
&SRC_STR_19="USBPHY1_pipe_clock"
&SRC_STR_20="USBPHY0_pipe_clock"
&SRC_STR_21="INTFPLL_clock"
&SRC_STR_22="MD2GPLL_clock"
&SRC_STR_23="DFEPLL_clock"
&SRC_STR_24="CMPPLL_clock"
&SRC_STR_25="ICCPLL_clock"
&SRC_STR_26="IMCPLL_clock"
&SRC_STR_27="EQPLL_clock"
&SRC_STR_28="BRPPLL_clock"
&SRC_STR_29="L1MCUPLL_clock"
&SRC_STR_30="PSMCUPLL_clock"
&SRC_STR_31="PLLGP_TST_CK"


;;;;;;;;;;;;;;;;;;;;;;;;;;;;;;;;;;;;;;;;;;;;;;;;;;;;;;;;;;;;;;;;;;;;;;;;;;;;;;;;

AREA

DIALOG
(&
    HEADER "PLL Frequency Meter"
    ICON ":chip"
    
    POS  0. 0. 20. 1.
    LINE "FQMTR Selection"
    ;    x  y  w   h
    POS  0. 1. 20. 1.
    SEL.NONE:   CHOOSEBOX "None"
    (
        &key_in=0x00
    )
    SEL.1:      CHOOSEBOX "&SRC_STR_1"
    (
        &key_in=0x1
        &key_str="&SRC_STR_1"
    )
    SEL.2:      CHOOSEBOX "&SRC_STR_2"
    (
        &key_in=0x2
        &key_str="&SRC_STR_2"
    )
    SEL.3:      CHOOSEBOX "&SRC_STR_3"
    (
        &key_in=0x3
        &key_str="&SRC_STR_3"
    )
    SEL.4:      CHOOSEBOX "&SRC_STR_4"
    (
        &key_in=0x4
        &key_str="&SRC_STR_4"
    )
    SEL.5:      CHOOSEBOX "&SRC_STR_5"
    (
        &key_in=0x5
        &key_str="&SRC_STR_5"
    )
    SEL.6:      CHOOSEBOX "&SRC_STR_6"
    (
        &key_in=0x6
        &key_str="&SRC_STR_6"
    )
    SEL.7:      CHOOSEBOX "&SRC_STR_7"
    (
        &key_in=0x7
        &key_str="&SRC_STR_7"
    )
    SEL.8:      CHOOSEBOX "&SRC_STR_8"
    (
        &key_in=0x8
        &key_str="&SRC_STR_8"
    )
    SEL.9:      CHOOSEBOX "&SRC_STR_9"
    (
        &key_in=0x9
        &key_str="&SRC_STR_9"
    )
    SEL.10:     CHOOSEBOX "&SRC_STR_10"
    (
        &key_in=0xA
        &key_str="&SRC_STR_10"
    )
    SEL.11:     CHOOSEBOX "&SRC_STR_11"
    (
        &key_in=0xB
        &key_str="&SRC_STR_11"
    )
    SEL.12:     CHOOSEBOX "&SRC_STR_12"
    (
        &key_in=0xC
        &key_str="&SRC_STR_12"
    )
    SEL.13:     CHOOSEBOX "&SRC_STR_13"
    (
        &key_in=0xD
        &key_str="&SRC_STR_13"
    )
    SEL.14:     CHOOSEBOX "&SRC_STR_14"
    (
        &key_in=0xE
        &key_str="&SRC_STR_14"
    )
    SEL.15:     CHOOSEBOX "&SRC_STR_15"
    (
        &key_in=0xF
        &key_str="&SRC_STR_15"
    )
    SEL.16:     CHOOSEBOX "&SRC_STR_16"
    (
        &key_in=0x10
        &key_str="&SRC_STR_16"
    )
    SEL.17:     CHOOSEBOX "&SRC_STR_17"
    (
        &key_in=0x11
        &key_str="&SRC_STR_17"
    )
    SEL.18:     CHOOSEBOX "&SRC_STR_18"
    (
        &key_in=0x12
        &key_str="&SRC_STR_18"
    )
    SEL.19:     CHOOSEBOX "&SRC_STR_19"
    (
        &key_in=0x13
        &key_str="&SRC_STR_19"
    )
    SEL.20:     CHOOSEBOX "&SRC_STR_20"
    (
        &key_in=0x14
        &key_str="&SRC_STR_20"
    )
    SEL.21:     CHOOSEBOX "&SRC_STR_21"
    (
        &key_in=0x15
        &key_str="&SRC_STR_21"
    )
    SEL.22:     CHOOSEBOX "&SRC_STR_22"
    (
        &key_in=0x16
        &key_str="&SRC_STR_22"
    )
    SEL.23:     CHOOSEBOX "&SRC_STR_23"
    (
        &key_in=0x17
        &key_str="&SRC_STR_23"
    )
    SEL.24:     CHOOSEBOX "&SRC_STR_24"
    (
        &key_in=0x18
        &key_str="&SRC_STR_24"
    )
    SEL.25:     CHOOSEBOX "&SRC_STR_25"
    (
        &key_in=0x19
        &key_str="&SRC_STR_25"
    )
    SEL.26:     CHOOSEBOX "&SRC_STR_26"
    (
        &key_in=0x1A
        &key_str="&SRC_STR_26"
    )
    SEL.27:     CHOOSEBOX "&SRC_STR_27"
    (
        &key_in=0x1B
        &key_str="&SRC_STR_27"
    )
    SEL.28:     CHOOSEBOX "&SRC_STR_28"
    (
        &key_in=0x1C
        &key_str="&SRC_STR_28"
    )
    SEL.29:     CHOOSEBOX "&SRC_STR_29"
    (
        &key_in=0x1D
        &key_str="&SRC_STR_29"
    )
    SEL.30:     CHOOSEBOX "&SRC_STR_30"
    (
        &key_in=0x1E
        &key_str="&SRC_STR_30"
    )
    SEL.31:     CHOOSEBOX "&SRC_STR_31"
    (
        &key_in=0x1F
        &key_str="&SRC_STR_31"
    )

    POS  21. 0. 20. 1.
    LINE "Explicit CVD Connection"
    SEL.CVD_NONE:       CHOOSEBOX "None"
    (
        &opt_cvd_connect="none"
    )
    SEL.CVD_CR4:        CHOOSEBOX "CR4 (No Reset)"
    (
        &opt_cvd_connect="cr4"
    )

    POSY 1. 20. 1.
    LINE "FQMTR Information"
    INFO1: EDIT "Window Seting: &fqmtr_winset" ""
    INFO2: EDIT "Fixed Clock: &fqmtr_fcksel_val" ""

    POSY 1. 20. 1.
    LINE "FQMTR Result"
    RESULT: EDIT "" ""

    POSY 1. 20. 1.
    DEFBUTTON "OK"
    (
        ;; Clear Result
        DIALOG.Set RESULT ""
        IF &key_in!=0
        (
            GOSUB fqmtr_query &key_in &key_str 1
        )
    )

    DEFBUTTON "LIST ALL"
    (
        ;; Clear Result
        DIALOG.Set RESULT ""
        GOSUB fqmtr_list_all
    )
  
    CLOSE 
    (
        PRINT "bye~"
        DIALOG.END
    )
)
    
    ;; Set default value to UI
    DIALOG.Set SEL.NONE
    DIALOG.Set SEL.CVD_NONE
    ;; Disable EDIT of showing information
    DIALOG.Disable INFO1
    DIALOG.Disable INFO2
    ;DIALOG.Disable RESULT
STOP
ENDDO

;;;;;;;;;;;;;;;;;;;;;;;;;;;;;;;;;;;;;;;;;;;;;;;;;;;;;;;;;;;;;;;;;;;;;;;;;;;;;;;;
fqmtr_query:
ENTRY &idx &str &info
(
    IF &info!=0
    (
        PRINT "&str: &idx"
        PRINT "fqmtrsrc: 0x" FORMAT.HEX(2,&idx)
        PRINT "opt_cvd_connect: &opt_cvd_connect"
    )

    LOCAL &unit
    LOCAL &fqmtr_result
    LOCAL &fqmtr_result_raw
    LOCAL &fqmtr_result_str
    LOCAL &safe_wait_cnt
    LOCAL &safe_wait_cnt_max

    &safe_wait_cnt=0
    &safe_wait_cnt_max=32

    IF &fqmtr_fcksel_val==0x1a
    (
        &unit="Mhz"
    )
    ELSE
    (
        &unit=""
    )
    
    IF "&opt_cvd_connect"=="cr4"
    (
        LOCAL &OPT_JTAG
        LOCAL_&OPT_CHECK_CPU_ID

        &OPT_JTAG=0
        &OPT_CHECK_CPU_ID=0

        DO CR4_connect.cmm
    )
    ELSE IF "&opt_cvd_connect"=="cr4_pll"
    (
        LOCAL &OPT_JTAG
        LOCAL_&OPT_CHECK_CPU_ID

        &OPT_JTAG=0
        &OPT_CHECK_CPU_ID=0

        DO CR4_connect.cmm RESET

        IF &info!=0
        (
            PRINT "MD PLL Init ..."
        )
        DO MT6595_MD_PLL_Init.cmm
    )
    ELSE IF "&opt_cvd_connect"=="ca7"
    (
        LOCAL &OPT_JTAG
        LOCAL &OPT_AP_NR_CPUS
        LOCAL &OPT_AP_COREBASE

        &OPT_JTAG=0
        &OPT_AP_NR_CPUS=2
        &OPT_AP_COREBASE="0x80070000 0x80072000"
        ;&OPT_AP_NR_CPUS=4
        ;&OPT_AP_COREBASE="0x80070000 0x80072000 0x80074000 0x80076000"
        DO CA7_connect.cmm
    )
    ELSE
    (
        IF &info!=0
        (
            PRINT "No explicit CVD connection, use current status"
        )
    )

    IF &idx==0
    (
        ;; This is used for connect CVD only, no FQMTR test
        RETURN
    )

	;;div 8 and select src
	Data.Set &mclass:(&pll_base+0x0104) %LE %LONG 0x0 ;reset frequency meter
	Data.Set &mclass:(&pll_base+0x0100) %LE %LONG (0x0300)|(&idx)
	Data.Set &mclass:(&pll_base+0x0108) %LE %LONG &fqmtr_winset
	Data.Set &mclass:(&pll_base+0x0104) %LE %LONG 0x1 ;enable frequency meter


	;; read status
    &fqmtr_busy=DATA.LONG(&mclass:(&pll_base+0x0104))&(1<<1)
    WHILE &fqmtr_busy==0
    (
        PRINT ". &fqmtr_busy"
        &fqmtr_busy=DATA.LONG(pm:(&pll_base+0x0104))&(1<<1)
        &safe_wait_cnt=&safe_wait_cnt+1
        IF &safe_wait_cnt==&safe_wait_cnt_max
        (
            PRINT "Wait Fail, exit"
            GOSUB CloseDialog
        )
    )
    &fqmtr_result_raw=DATA.LONG(&mclass:(&pll_base+0x10c))
    &fqmtr_result=&fqmtr_result_raw*&fqmtr_fcksel_val*8/&fqmtr_winset
    &fqmtr_result_dec=FORMAT.DECIMAL(0,&fqmtr_result)
    &fqmtr_result_str=""+FORMAT.DECIMAL(0,&fqmtr_result)+" &unit"
    IF &info==0
    (
        PRINT "0x" FORMAT.HEX(2,&idx) ",&fqmtr_result_dec,&unit,&str,&fqmtr_result_raw,"
    )
    ELSE
    (
        PRINT "Frequency Meter Result: &fqmtr_result_str (&fqmtr_result_raw)"
        PRINT ""
    )
    DIALOG.Set RESULT "&fqmtr_result_str"

    IF &info==0
    (
        WAIT 5ms
    )

    RETURN
)
;;;;;;;;;;;;;;;;;;;;;;;;;;;;;;;;;;;;;;;;;;;;;;;;;;;;;;;;;;;;;;;;;;;;;;;;;;;;;;;;
fqmtr_list_all:
(
    GOSUB fqmtr_query  0x1 &SRC_STR_1  0
    GOSUB fqmtr_query  0x1 &SRC_STR_1  0
    GOSUB fqmtr_query  0x2 &SRC_STR_2  0
    GOSUB fqmtr_query  0x3 &SRC_STR_3  0
    GOSUB fqmtr_query  0x4 &SRC_STR_4  0
    GOSUB fqmtr_query  0x5 &SRC_STR_5  0
    GOSUB fqmtr_query  0x6 &SRC_STR_6  0
    GOSUB fqmtr_query  0x7 &SRC_STR_7  0
    GOSUB fqmtr_query  0x8 &SRC_STR_8  0
    GOSUB fqmtr_query  0x9 &SRC_STR_9  0
    GOSUB fqmtr_query  0xA &SRC_STR_10 0
    GOSUB fqmtr_query  0xB &SRC_STR_11 0
    ;GOSUB fqmtr_query  0xC &SRC_STR_12 0
    ;GOSUB fqmtr_query  0xD &SRC_STR_13 0
    ;GOSUB fqmtr_query  0xE &SRC_STR_14 0
    GOSUB fqmtr_query  0xF &SRC_STR_15 0
    GOSUB fqmtr_query 0x10 &SRC_STR_16 0
    GOSUB fqmtr_query 0x11 &SRC_STR_17 0
    GOSUB fqmtr_query 0x12 &SRC_STR_18 0
   GOSUB fqmtr_query 0x13 &SRC_STR_19 0
   ; GOSUB fqmtr_query 0x14 &SRC_STR_20 0
    GOSUB fqmtr_query 0x15 &SRC_STR_21 0
    GOSUB fqmtr_query 0x16 &SRC_STR_22 0
    GOSUB fqmtr_query 0x17 &SRC_STR_23 0
    GOSUB fqmtr_query 0x18 &SRC_STR_24 0
    GOSUB fqmtr_query 0x19 &SRC_STR_25 0
    GOSUB fqmtr_query 0x1A &SRC_STR_26 0
    GOSUB fqmtr_query 0x1B &SRC_STR_27 0
    GOSUB fqmtr_query 0x1C &SRC_STR_28 0
    GOSUB fqmtr_query 0x1D &SRC_STR_29 0
    GOSUB fqmtr_query 0x1E &SRC_STR_30 0
    ;GOSUB fqmtr_query 0x1F &SRC_STR_31 0
    RETURN
)
